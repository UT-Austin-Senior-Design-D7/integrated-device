/*
  Rui Santos
  Complete project details at https://RandomNerdTutorials.com/esp32-cam-post-image-photo-server/
  
  Permission is hereby granted, free of charge, to any person obtaining a copy
  of this software and associated documentation files.
  
  The above copyright notice and this permission notice shall be included in all
  copies or substantial portions of the Software.
*/

#include <Arduino.h>
#include <WiFi.h>
#include <WiFiClientSecure.h>
#include "soc/soc.h"
#include "soc/rtc_cntl_reg.h"
#include "esp_camera.h"
#include <Adafruit_GFX.h>    // Core graphics library
#include <Adafruit_ST7735.h> // Hardware-specific library
#include <SPI.h>

#if (defined(__AVR__))
#include <avr\pgmspace.h>
#else
#include <pgmspace.h>
#endif

#define echoPin 13 // attach pin D19 Arduino to pin Echo of HC-SR04
#define trigPin 15 //attach pin D22 Arduino to pin Trig of HC-SR04

// For the breakout, you can use any 2 or 3 pins
// These pins will also work for the 1.8" TFT shield
#define TFT_CS     21 // plug into 21
#define TFT_RST    12  // you can also connect this to the Arduino reset
                      // in which case, set this #define pin to 0!
#define TFT_DC     33 // changed from 14

//Adafruit_ST7735 tft = Adafruit_ST7735(TFT_CS,  TFT_DC, TFT_RST);

// Option 2: use any pins but a little slower!
#define TFT_SCLK 14   // set these to be whatever pins you like! from 18
#define TFT_MOSI 32   // set these to be whatever pins you like! from 23
Adafruit_ST7735 tft = Adafruit_ST7735(TFT_CS, TFT_DC, TFT_MOSI, TFT_SCLK, TFT_RST);

static const unsigned char IWB8012[]PROGMEM = {
0x00, 0x00, 0x00, 0x00, 0x00, 0x00, 0x00, 0x00, 0x00, 0x00, 
0x00, 0x00, 0x00, 0x00, 0x00, 0x00, 0x00, 0x00, 0x00, 0x00, 
0x30, 0x00, 0xc6, 0x30, 0x00, 0x18, 0x00, 0x1f, 0xcc, 0x00, 
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0x00, 0x00, 0x00, 0x00, 0x00, 0x00, 0x00, 0x00, 0x00, 0x00
};
  
static const unsigned char waste7221[]PROGMEM = {
0x00, 0x00, 0x00, 0x00, 0x00, 0x00, 0x00, 0x00, 0x00, 
0x00, 0x00, 0x00, 0x00, 0x00, 0x00, 0x00, 0x00, 0x00, 
0x00, 0x00, 0x00, 0x00, 0x00, 0x00, 0x00, 0x00, 0x00, 
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0x00, 0x00, 0x00, 0x00, 0x00, 0x00, 0x00, 0x00, 0x00
};

static const unsigned char PL7020[]PROGMEM = {
0x00, 0x00, 0x00, 0x00, 0x00, 0x00, 0x00, 0x00, 0x00, 
0x00, 0x00, 0x00, 0x00, 0x00, 0x00, 0x00, 0x00, 0x00, 
0x00, 0x00, 0x00, 0x00, 0x00, 0x00, 0x00, 0x00, 0x00, 
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0x00, 0x00, 0x00, 0x00, 0x00, 0x00, 0x00, 0x00, 0x00  
};

static const unsigned char MT5420[]PROGMEM = {
 0x00, 0x00, 0x00, 0x00, 0x00, 0x00, 0x00, 
0x00, 0x00, 0x00, 0x00, 0x00, 0x00, 0x00, 
0x1e, 0x03, 0x80, 0x00, 0x00, 0x00, 0x60, 
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0x00, 0x00, 0x00, 0x00, 0x00, 0x00, 0x00
};

static const unsigned char CB10920[]PROGMEM = {
0x00, 0x00, 0x00, 0x00, 0x00, 0x00, 0x00, 0x00, 0x00, 0x00, 0x00, 0x00, 0x00, 0x00, 
0x00, 0x00, 0x00, 0x00, 0x00, 0x00, 0x00, 0x00, 0x00, 0x00, 0x00, 0x00, 0x00, 0x00, 
0x00, 0x00, 0x00, 0x00, 0x00, 0x00, 0x00, 0x00, 0x00, 0x00, 0x00, 0x00, 0x00, 0x00, 
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0x00, 0x00, 0x00, 0x00, 0x00, 0x00, 0x00, 0x00, 0x00, 0x00, 0x00, 0x00, 0x00, 0x00
};

static const unsigned char IR5712[]PROGMEM = {
0x00, 0x00, 0x00, 0x00, 0x00, 0x00, 0x00, 0x00, 
0x00, 0x00, 0x00, 0x00, 0x00, 0x00, 0x00, 0x00, 
0x60, 0x07, 0xc0, 0x00, 0x00, 0x68, 0x00, 0x00, 
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0x00, 0x00, 0x00, 0x00, 0x00, 0x00, 0x00, 0x00
};

static const unsigned char PPI7410[]PROGMEM = {
0x00, 0x00, 0x00, 0x00, 0x00, 0x00, 0x00, 0x00, 0x00, 0x00, 
0x3c, 0x80, 0x00, 0x00, 0x1e, 0x00, 0x04, 0x00, 0x00, 0x00, 
0x36, 0x80, 0x00, 0x00, 0x1b, 0x01, 0x86, 0xc0, 0x00, 0x00, 
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0x00, 0x00, 0x00, 0x00, 0x00, 0x00, 0x00, 0x00, 0x00, 0x00
};

static const unsigned char wave[]PROGMEM = {
0x00, 0x00, 0x00, 0x00, 0x00, 0x00, 0x00, 0x00, 0x00, 0x00, 0x00, 0x00, 0x00, 0x00, 0x00, 0x00, 
0x00, 0x00, 0x00, 0x00, 0x00, 0x00, 0x00, 0x00, 0x00, 0x00, 0x00, 0x00, 0x00, 0x00, 0x00, 0x00, 
0x00, 0x40, 0x00, 0x00, 0x00, 0x00, 0x00, 0x00, 0x00, 0x00, 0x00, 0x00, 0x00, 0x00, 0x00, 0x00, 
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0x00, 0x00, 0x00, 0x00, 0x00, 0x00, 0x00, 0x00, 0x00, 0x00, 0x00, 0x00, 0x00, 0x00, 0x00, 0x00
};

static const unsigned char process[]PROGMEM = {
0x00, 0x00, 0x00, 0x00, 0x00, 0x00, 0x00, 0x00, 0x00, 0x00, 0x00, 0x00, 
0x00, 0x00, 0x00, 0x00, 0x00, 0x00, 0x00, 0x00, 0x00, 0x00, 0x00, 0x00, 
0x00, 0x00, 0x00, 0x00, 0x00, 0x00, 0x00, 0x00, 0x00, 0x00, 0x00, 0x00, 
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0x00, 0x00, 0x00, 0x00, 0x00, 0x00, 0x00, 0x00, 0x00, 0x00, 0x00, 0x00
};


static const unsigned char bin28[]PROGMEM = {
0x00, 0x00, 0x00, 0x00, 
0x00, 0x00, 0x00, 0x00, 
0x00, 0x00, 0x00, 0x00, 
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0x00, 0x00, 0x00, 0x00
};

static const unsigned char cam[]PROGMEM = {
0x00, 0x00, 0x00, 0x00, 
0x00, 0x00, 0x00, 0x00, 
0x00, 0x00, 0x00, 0x00, 
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0x00, 0x00, 0x00, 0x00
};

static const unsigned char bin115[]PROGMEM = {
0xff, 0xff, 0xff, 0xff, 0xff, 0xff, 0xff, 0xff, 0xff, 0xff, 0xff, 0xff, 0xff, 0xff, 0xe0, 
0xff, 0xff, 0xff, 0xff, 0xff, 0xff, 0xff, 0xff, 0xff, 0xff, 0xff, 0xff, 0xff, 0xff, 0xe0, 
0xff, 0xff, 0xff, 0xff, 0xff, 0xff, 0xff, 0xff, 0xff, 0xff, 0xff, 0xff, 0xff, 0xff, 0xe0, 
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0xff, 0xff, 0xff, 0xff, 0xff, 0xff, 0xff, 0xff, 0xff, 0xff, 0xff, 0xff, 0xff, 0xff, 0xe0
};

static const unsigned char bin110[]PROGMEM = {
0x00, 0x00, 0x00, 0x00, 0x00, 0x00, 0x00, 0x00, 0x00, 0x00, 0x00, 0x00, 0x00, 0x00, 
0x00, 0x00, 0x00, 0x00, 0x00, 0x00, 0x00, 0x00, 0x00, 0x00, 0x00, 0x00, 0x00, 0x00, 
0x00, 0x00, 0x00, 0x00, 0x00, 0x00, 0x00, 0x00, 0x00, 0x00, 0x00, 0x00, 0x00, 0x00, 
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0x00, 0x00, 0x00, 0x00, 0x00, 0x00, 0x00, 0x00, 0x00, 0x00, 0x00, 0x00, 0x00, 0x00
};

void startup() {
  tft.fillScreen(0xFFFF);
  tft.fillRect(0, 0, 128, 40, 0x1CDA);
  tft.fillRect(0, 116, 128, 44, 0x1CDA);
  tft.fillRect(0, 40, 6, 76, 0x1CDA);
  tft.fillRect(121, 40, 7, 76, 0x1CDA);
  tft.drawBitmap(6, 40, bin115, 115, 76, 0x1CDA);
  delay(1500);
  tft.fillScreen(0x1CDA);
}

void waitscreen(){
  //tft.fillScreen(0x1CDA);
  tft.drawBitmap(7, 50, bin110, 110, 110, 0xFFFF);
  tft.drawBitmap(0, 10, wave, 128, 19, 0xFFFF);
  
}

void waved(){
  tft.fillRect(0, 10, 128, 19, 0x1CDA);
  tft.drawBitmap(48, 10, cam, 30, 30, 0xFFFF);
  delay(4000);
  tft.fillRect(48, 10, 30, 30, 0x1CDA);
  delay(90);
  tft.drawBitmap(48, 10, cam, 30, 30, 0xFFFF);
  tft.fillRect(48, 10, 30, 30, 0x1CDA);
  delay(50);
  tft.drawBitmap(48, 10, cam, 30, 30, 0xFFFF);
}

void processing(){
  delay(200);
  tft.fillRect(48, 10, 30, 30, 0x1CDA);
  tft.drawBitmap(10, 20, process, 93, 20, 0xFFFF);
}
void prowait(){
  tft.fillRect(105, 33, 3, 3, 0xFFFF);
  delay(800);
  tft.fillRect(111, 33, 3, 3, 0xFFFF);
  delay(800);
  tft.fillRect(117, 33, 3, 3, 0xFFFF);
  delay(800);
  tft.fillRect(105, 33, 3, 3, 0x1CDA);
  tft.fillRect(111, 33, 3, 3, 0x1CDA);
  tft.fillRect(117, 33, 3, 3, 0x1CDA);
}

void results(int n){
  tft.fillRect(10, 20, 93, 20, 0x1CDA);
  switch(n)
{
  case 1:
      tft.drawBitmap(7, 50, bin110, 110, 110, 0x0FA0);
      tft.drawBitmap(10, 20, CB10920, 109, 20, 0xFFFF);
      tft.drawBitmap(10, 40, PPI7410, 74, 10, 0xFFFF);
      tft.drawBitmap(30, 50, IR5712, 57, 12, 0xFFFF);
      break;
  case 2:
      tft.drawBitmap(7, 50, bin110, 110, 110, 0x0FA0);
      tft.drawBitmap(30, 20, PL7020, 70, 20, 0xFFFF);
      tft.drawBitmap(18, 40, PPI7410, 74, 10, 0xFFFF);
      tft.drawBitmap(38, 50, IR5712, 57, 12, 0xFFFF);
      break;
  case 3:
      tft.drawBitmap(7, 50, bin110, 110, 110, 0x0FA0);
      tft.drawBitmap(33, 20, MT5420, 54, 20, 0xFFFF);
      tft.drawBitmap(18, 40, PPI7410, 74, 10, 0xFFFF);
      tft.drawBitmap(38, 50, IR5712, 57, 12, 0xFFFF);
      break;
  default:
      tft.drawBitmap(7, 50, bin110, 110, 110, 0xA333);
      tft.drawBitmap(20, 20, waste7221, 72, 21, 0xFFFF);
      tft.drawBitmap(15, 40, PPI7410, 74, 10, 0xFFFF);
      tft.drawBitmap(35, 50, IWB8012, 80, 12, 0xFFFF);
      break;
}
  //Texts for three options
  //"Discard in _______
}



long duration; // variable for the duration of sound wave travel
int distance; // variable for the distance measurement

const char* ssid = "iphone"; //ATTGBRTTna
const char* password = "password1"; //9hwnxu=w%2a=

#define CAMERA_MODEL_WROVER_KIT // Has PSRAM

#include "camera_pins.h"

//String serverName = "192.168.1.XXX";   // REPLACE WITH YOUR Raspberry Pi IP ADDRESS
String serverName = "binitdatabase.tk";   // OR REPLACE WITH YOUR DOMAIN NAME // http://seniordesignd7photouploads.com/ //binitdatabase.tk

String serverPath = "/upload/1";     // The default serverPath should be upload.php // 

const int serverPort = 443; //443 //80

WiFiClientSecure client;


const int timerInterval = 30000;    // time between each HTTP POST image
unsigned long previousMillis = 0;   // last time image was sent

void setup() {
  //WRITE_PERI_REG(RTC_CNTL_BROWN_OUT_REG, 0); 
  Serial.begin(9600);

  pinMode(trigPin, OUTPUT); // Sets the trigPin as an OUTPUT
  pinMode(echoPin, INPUT); // Sets the echoPin as an INPUT
    
  // Use this initializer if you're using a 1.8" TFT
  tft.initR(INITR_BLACKTAB);   // initialize a ST7735S chip, black tab
  tft.invertDisplay(false);

  Serial.println("Initialized");

  tft.fillScreen(ST7735_BLACK);

  delay(2000);

  startup();

  client.setInsecure();  

  WiFi.mode(WIFI_STA);
  Serial.println();
  Serial.print("Connecting to ");
  Serial.println(ssid);
  WiFi.begin(ssid, password);  
  while (WiFi.status() != WL_CONNECTED) {
    Serial.print(".");
    delay(500);
  }
  Serial.println();
  Serial.print("ESP32-CAM IP Address: ");
  Serial.println(WiFi.localIP());

  camera_config_t config;
  config.ledc_channel = LEDC_CHANNEL_0;
  config.ledc_timer = LEDC_TIMER_0;
  config.pin_d0 = Y2_GPIO_NUM;
  config.pin_d1 = Y3_GPIO_NUM;
  config.pin_d2 = Y4_GPIO_NUM;
  config.pin_d3 = Y5_GPIO_NUM;
  config.pin_d4 = Y6_GPIO_NUM;
  config.pin_d5 = Y7_GPIO_NUM;
  config.pin_d6 = Y8_GPIO_NUM;
  config.pin_d7 = Y9_GPIO_NUM;
  config.pin_xclk = XCLK_GPIO_NUM;
  config.pin_pclk = PCLK_GPIO_NUM;
  config.pin_vsync = VSYNC_GPIO_NUM;
  config.pin_href = HREF_GPIO_NUM;
  config.pin_sscb_sda = SIOD_GPIO_NUM;
  config.pin_sscb_scl = SIOC_GPIO_NUM;
  config.pin_pwdn = PWDN_GPIO_NUM;
  config.pin_reset = RESET_GPIO_NUM;
  config.xclk_freq_hz = 20000000;
  config.pixel_format = PIXFORMAT_JPEG;

  // init with high specs to pre-allocate larger buffers
  if(psramFound()){
    config.frame_size = FRAMESIZE_SVGA;
    config.jpeg_quality = 10;  //0-63 lower number means higher quality
    config.fb_count = 2;
  } else {
    config.frame_size = FRAMESIZE_CIF;
    config.jpeg_quality = 12;  //0-63 lower number means higher quality
    config.fb_count = 1;
  }
  
  // camera init
  esp_err_t err = esp_camera_init(&config);
  if (err != ESP_OK) {
    Serial.printf("Camera init failed with error 0x%x", err);
    delay(1000);
    ESP.restart();
  }



  //sendPhoto(); 
}

void loop() {
  waitscreen();
  // Clears the trigPin condition
  digitalWrite(trigPin, LOW);
  delayMicroseconds(2);
  // Sets the trigPin HIGH (ACTIVE) for 10 microseconds
  digitalWrite(trigPin, HIGH);
  delayMicroseconds(10);
  digitalWrite(trigPin, LOW);
  // Reads the echoPin, returns the sound wave travel time in microseconds
  duration = pulseIn(echoPin, HIGH);
  // Calculating the distance
  distance = duration * 0.034 / 2; // Speed of sound wave divided by 2 (go and back)
  Serial.println(distance);
  if(distance < 10){
    delay(500);
    // Clears the trigPin condition
    digitalWrite(trigPin, LOW);
    delayMicroseconds(2);
    // Sets the trigPin HIGH (ACTIVE) for 10 microseconds
    digitalWrite(trigPin, HIGH);
    delayMicroseconds(10);
    digitalWrite(trigPin, LOW);
    // Reads the echoPin, returns the sound wave travel time in microseconds
    duration = pulseIn(echoPin, HIGH);
    // Calculating the distance
    distance = duration * 0.034 / 2; // Speed of sound wave divided by 2 (go and back)
    if(distance < 10){
      waved();
      unsigned long currentMillis = millis();
      if (currentMillis - previousMillis >= timerInterval) {
        processing();
        sendPhoto();
        previousMillis = currentMillis;
      }
    }
    else{
     waitscreen();
    }
  }
  else{
    waitscreen();
  }
  

}

String sendPhoto() {
  String getAll;
  String getBody;
  String forDisplay;

  camera_fb_t * fb = NULL;
  fb = esp_camera_fb_get();
  if(!fb) {
    Serial.println("Camera capture failed");
    delay(1000);
    ESP.restart();
  }
  
  Serial.println("Connecting to server: " + serverName);

  if (client.connect(serverName.c_str(), serverPort)) {
    Serial.println("Connection successful!");    
    String head = "--RandomNerdTutorials\r\nContent-Disposition: form-data; name=\"file\"; filename=\"esp32-cam.jpg\"\r\nContent-Type: image/jpeg\r\n\r\n";
    String tail = "\r\n--RandomNerdTutorials--\r\n";

    uint32_t imageLen = fb->len;
    uint32_t extraLen = head.length() + tail.length();
    uint32_t totalLen = imageLen + extraLen;
  
    client.println("POST " + serverPath + " HTTP/1.1");
    client.println("Host: " + serverName);
    client.println("Content-Length: " + String(totalLen));
    client.println("Content-Type: multipart/form-data; boundary=RandomNerdTutorials");
    client.println();
    client.print(head);

    Serial.println("POST " + serverPath + " HTTP/1.1");
    Serial.println("Host: " + serverName);
    Serial.println("Content-Length: " + String(totalLen));
    Serial.println("Content-Type: multipart/form-data; boundary=RandomNerdTutorials");
    Serial.println();
    Serial.print(head);

  
    uint8_t *fbBuf = fb->buf;
    size_t fbLen = fb->len;
    for (size_t n=0; n<fbLen; n=n+1024) {
      if (n+1024 < fbLen) {
        client.write(fbBuf, 1024);
        fbBuf += 1024;
      }
      else if (fbLen%1024>0) {
        size_t remainder = fbLen%1024;
        client.write(fbBuf, remainder);
      }
    }   
    client.print(tail);
    
    esp_camera_fb_return(fb);

    prowait();
    
    int timoutTimer = 20000;
    long startTimer = millis();
    boolean state = false;
    
    while ((startTimer + timoutTimer) > millis()) {
      Serial.print(".");
      delay(100);      
      while (client.available()) {
        char c = client.read();
        if (c == '\n') {
          if (getAll.length()==0) { state=true; }
          getAll = "";
        }
        else if (c != '\r') { getAll += String(c); }
        if (state==true) { getBody += String(c); }
        startTimer = millis();
      }
      if (getBody.length()>0) { break; }
    }
    Serial.println();
    client.stop();
    Serial.println(getBody);
    forDisplay = getBody;
    forDisplay.remove(0,20);
    Serial.println(forDisplay);
    if(forDisplay.startsWith("cardboard")|| forDisplay.startsWith("paper")){
      results(1);
    }
    else if(forDisplay.startsWith("plastic") || forDisplay.startsWith("glass")){
      results(2);
    }
    else if(forDisplay.startsWith("metal")){
      results(3);
    }
    else{
      results(4);
    }
  }
  else {
    getBody = "Connection to " + serverName +  " failed.";
    Serial.println(getBody);
  }
  delay(6000);
  tft.fillScreen(0x1CDA);
  return getBody;
}
